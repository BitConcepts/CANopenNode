## zephyr/Kconfig
```kconfig
# SPDX-License-Identifier: Apache-2.0
# Copyright (c) 2025 BitConcepts, LLC
#
# CANopenNode — Zephyr module Kconfig
#
# This Kconfig file exposes CANopenNode features to Zephyr as CONFIG_* options.
# It lets you enable/disable protocol modules (NMT, SDO, PDO, etc.), choose
# Zephyr-specific integrations (storage backend, LED GPIO bridge), and set
# module-level parameters (buffers, timeouts, thread options).
#
# @file        Kconfig
# @author      BitConcepts, LLC <https://github.com/BitConcepts>
#
# This file is part of <https://github.com/CANopenNode/CANopenNode>, a CANopen Stack.
#
# Licensed under the Apache License, Version 2.0 (the "License"); you may not use this
# file except in compliance with the License. You may obtain a copy of the License at
#
#     http://www.apache.org/licenses/LICENSE-2.0
#
# Unless required by applicable law or agreed to in writing, software distributed under the License
# is distributed on an "AS IS" BASIS, WITHOUT WARRANTIES OR CONDITIONS OF ANY KIND, either express
# or implied. See the License for the specific language governing permissions and limitations under
# the License.
#
# Usage notes:
# - Enable top-level CONFIG_CANOPENNODE=y in prj.conf to include the stack.
# - Most options default to sensible values; adjust per application needs.
# - Some features imply others via 'select' (see help for each symbol).
# - For LED helpers (CiA 303-3), provide devicetree aliases:
#     aliases {
#       co_led_run = &led0;
#       co_led_err = &led1;
#     };
# - For Object Dictionary generation, set CONFIG_CANOPENNODE_EDS_FILE_PATH
#   to an EDS relative to your application root (see CMakeLists.txt logic).

menuconfig CANOPENNODE
	bool "CANopenNode protocol stack support"
	depends on CAN
	default y
	help
	  Enable the CANopenNode stack integration for Zephyr.

if CANOPENNODE

menu "NMT / Heartbeat producer - Specified in standard CiA 301"

config CANOPENNODE_NMT_CALLBACK_CHANGE
	bool "Enable custom callback after NMT state changes"
	default y
	help
	  Enable a custom callback invoked after the NMT state changes.
	  Configure via CO_NMT_initCallbackChanged().

config CANOPENNODE_NMT_MASTER
	bool "Enable simple NMT master"
	default n
	help
	  Enable a simple NMT master object to control other nodes'
	  NMT states (start/stop/reset).

config CANOPENNODE_NMT_CALLBACK
	bool "Enable custom callback after preprocessing received NMT message"
	default n
	help
	  Enable a custom callback invoked after a received NMT message
	  is preprocessed. Configure via CO_NMT_initCallbackPre().

config CANOPENNODE_NMT_TIMERNEXT
	bool "Enable NMT timerNext_us calculation"
	default y
	help
	  Enable calculation of timerNext_us for NMT to schedule next processing.

config CANOPENNODE_NMT_FIRST_HB_TIME_MS
	int "First heartbeat delay (ms)"
	range 0 65535
	default 0
	help
	  Delay before the first Heartbeat after boot/reset.
	  0 = no extra delay (start HB with the normal 0x1017 period).
	  Typical values: 200-1000 ms to let peers install filters and avoid
	  false HB-consumer timeouts during bus bring-up.

endmenu

menu "NMT startup/control"

config CANOPENNODE_NMT_STARTUP_TO_OPERATIONAL
	bool "Start in Operational after init (CO_NMT_STARTUP_TO_OPERATIONAL)"
	default y

config CANOPENNODE_NMT_ERR_ON_BUSOFF_HB
	bool "Error on bus-off / HB timeout (CO_NMT_ERR_ON_BUSOFF_HB)"
	default y

config CANOPENNODE_NMT_ERR_ON_ERR_REG
	bool "Error on nonzero masked error register (CO_NMT_ERR_ON_ERR_REG)"
	default y

config CANOPENNODE_NMT_ERR_TO_STOPPED
	bool "On error -> go to Stopped (else Pre-op) (CO_NMT_ERR_TO_STOPPED)"
	default n

config CANOPENNODE_NMT_ERR_FREE_TO_OPERATIONAL
	bool "Auto-return to Operational when errors clear (CO_NMT_ERR_FREE_TO_OPERATIONAL)"
	default y

comment "Error register mask (low 8 bits of NMT control)"

endmenu

menu "Heartbeat consumer - Specified in standard CiA 301"

config CANOPENNODE_HB_CONS_ENABLE
	bool "Enable heartbeat consumer"
	default y
	help
	  Monitor heartbeat messages from other nodes and trigger actions
	  based on their status.

choice CANOPENNODE_HB_CONS_CALLBACK_MODE
	prompt "Heartbeat consumer callback mode"
	depends on CANOPENNODE_HB_CONS_ENABLE
	optional
	default CANOPENNODE_HB_CONS_CALLBACK_CHANGE
	help
	  Select how heartbeat/NMT-change callbacks are handled.
	  Leave unset for no callbacks. Only one option can be active.

config CANOPENNODE_HB_CONS_CALLBACK_CHANGE
	bool "Single common callback after NMT state change"
	help
	  Enable a single common callback invoked on NMT state changes.
	  Configure via CO_HBconsumer_initCallbackNmtChanged().

config CANOPENNODE_HB_CONS_CALLBACK_MULTI
	bool "Per-node callbacks"
	help
	  Enable per-node callbacks for NMT change, heartbeat started,
	  timeout, and remote reset. Configure via:
	  CO_HBconsumer_initCallbackNmtChanged(),
	  CO_HBconsumer_initCallbackHeartbeatStarted(),
	  CO_HBconsumer_initCallbackTimeout(),
	  CO_HBconsumer_initCallbackRemoteReset().

endchoice

config CANOPENNODE_HB_CONS_QUERY_FUNCT
	bool "Enable heartbeat and NMT query functions"
	depends on CANOPENNODE_HB_CONS_ENABLE
	default n

config CANOPENNODE_HB_CONS_CALLBACK
	bool "Enable custom callback after heartbeat message received"
	depends on CANOPENNODE_HB_CONS_ENABLE
	default n
	help
	  Enable a callback invoked after a heartbeat message is preprocessed.
	  Configure via CO_HBconsumer_initCallbackPre().

config CANOPENNODE_HB_CONS_TIMERNEXT
	bool "Enable heartbeat consumer timerNext_us calculation"
	depends on CANOPENNODE_HB_CONS_ENABLE
	default y

config CANOPENNODE_HB_CONS_OD_DYNAMIC
	bool "Enable dynamic behaviour of heartbeat consumer OD variables"
	depends on CANOPENNODE_HB_CONS_ENABLE
	default y

endmenu

menu "CANopen Node Guarding slave and master objects - Specified in standard CiA 301"

config CANOPENNODE_NODE_GUARDING_SLAVE_ENABLE
	bool "Enable Node guarding slave"
	default n

config CANOPENNODE_NODE_GUARDING_MASTER_ENABLE
	bool "Enable Node guarding master"
	default n

config CANOPENNODE_NODE_GUARDING_MASTER_COUNT
	int "Max nodes monitored by guarding master"
	range 1 127
	default 127

config CANOPENNODE_NODE_GUARDING_TIMERNEXT
	bool "Enable Node guarding timerNext_us calculation"
	depends on CANOPENNODE_NODE_GUARDING_SLAVE_ENABLE || CANOPENNODE_NODE_GUARDING_MASTER_ENABLE
	default n

endmenu

menu "Emergency producer/consumer - Specified in standard CiA 301"

config CANOPENNODE_EM_PRODUCER
	bool "Enable emergency producer"
	default y

config CANOPENNODE_EM_PROD_CONFIGURABLE
	bool "Enable configurable COB-ID for emergency producer"
	default n

config CANOPENNODE_EM_PROD_INHIBIT
	bool "Enable inhibit time for emergency producer"
	default n

config CANOPENNODE_EM_HISTORY
	bool "Enable emergency error history"
	default y

config CANOPENNODE_EM_CONSUMER
	bool "Enable emergency consumer"
	default n

config CANOPENNODE_EM_STATUS_BITS
	bool "Enable emergency status bits in Object Dictionary"
	default n

config CANOPENNODE_EM_CALLBACK
	bool "Enable custom callback after emergency message received"
	default y

config CANOPENNODE_EM_TIMERNEXT
	bool "Enable emergency timerNext_us calculation"
	default y

config CANOPENNODE_EM_ERR_STATUS_BITS_COUNT
	int "Emergency error status bits (multiple of 8)"
	range 48 256
	default 80

# Optional error-register conditions (enable default expressions in mapper)
config CANOPENNODE_ERR_CONDITION_CURRENT
	bool "Condition for calculating Error register: CURRENT"
	default n

config CANOPENNODE_ERR_CONDITION_VOLTAGE
	bool "Condition for calculating Error register: VOLTAGE"
	default n

config CANOPENNODE_ERR_CONDITION_TEMPERATURE
	bool "Condition for calculating Error register: TEMPERATURE"
	default n

config CANOPENNODE_ERR_CONDITION_DEV_PROFILE
	bool "Condition for calculating Error register: DEVICE PROFILE"
	default n

endmenu

menu "SDO server - Specified in standard CiA 301"

config CANOPENNODE_SDO_SERVER_SEGMENTED
	bool "Enable segmented SDO server"
	default y

config CANOPENNODE_SDO_SERVER_BLOCK
	bool "Enable block SDO server"
	select CANOPENNODE_SDO_SERVER_SEGMENTED
	select CANOPENNODE_CRC16_ENABLE
	default n
	help
	  Use 127-segment block transfers with optional CRC for large, efficient transfers.

config CANOPENNODE_SDO_SERVER_CALLBACK
	bool "Enable SDO server callback"
	depends on CANOPENNODE_SDO_SERVER_SEGMENTED || CANOPENNODE_SDO_SERVER_BLOCK
	default y

config CANOPENNODE_SDO_SERVER_TIMERNEXT
	bool "Enable SDO server timerNext_us calculation"
	depends on CANOPENNODE_SDO_SERVER_SEGMENTED || CANOPENNODE_SDO_SERVER_BLOCK
	default y

config CANOPENNODE_SDO_SERVER_OD_DYNAMIC
	bool "Enable dynamic behaviour of SDO server OD variables"
	depends on CANOPENNODE_SDO_SERVER_SEGMENTED || CANOPENNODE_SDO_SERVER_BLOCK
	default y

config CANOPENNODE_SDO_SERVER_BUFFER_SIZE
	int "SDO server buffer size"
	range 900 4096 if CANOPENNODE_SDO_SERVER_BLOCK
	range 20 4096 if !CANOPENNODE_SDO_SERVER_BLOCK
	default 900 if CANOPENNODE_SDO_SERVER_BLOCK
	default 32
	help
	  Internal buffer for SDO server.
	  - >=20 for segmented
	  - >=900 recommended for block (127 x 7 bytes)

config CANOPENNODE_SDO_SERVER_TIMEOUT_MS
	int "SDO server timeout (ms)"
	range 50 60000
	default 1000

endmenu

menu "SDO client - Specified in standard CiA 301"

config CANOPENNODE_SDO_CLIENT_ENABLE
	bool "Enable SDO client"
	select CANOPENNODE_FIFO_ENABLE
	default n

config CANOPENNODE_SDO_CLIENT_SEGMENTED
	bool "Enable SDO client segmented transfer"
	depends on CANOPENNODE_SDO_CLIENT_ENABLE
	default n

config CANOPENNODE_SDO_CLIENT_BLOCK
	bool "Enable SDO client block transfer"
	depends on CANOPENNODE_SDO_CLIENT_ENABLE
	select CANOPENNODE_SDO_CLIENT_SEGMENTED
	select CANOPENNODE_FIFO_ALT_READ
	select CANOPENNODE_FIFO_CRC16_CCITT
	default n

config CANOPENNODE_SDO_CLIENT_LOCAL
	bool "Enable local transfer (client/server same node)"
	depends on CANOPENNODE_SDO_CLIENT_ENABLE
	default n

config CANOPENNODE_SDO_CLIENT_CALLBACK
	bool "Enable SDO client callback"
	depends on CANOPENNODE_SDO_CLIENT_ENABLE
	default n

config CANOPENNODE_SDO_CLIENT_TIMERNEXT
	bool "Enable SDO client timerNext_us calculation"
	depends on CANOPENNODE_SDO_CLIENT_ENABLE
	default n

config CANOPENNODE_SDO_CLIENT_OD_DYNAMIC
	bool "Enable dynamic behaviour of SDO client OD variables"
	depends on CANOPENNODE_SDO_CLIENT_ENABLE
	default n

config CANOPENNODE_SDO_CLIENT_BUFFER_SIZE
	int "SDO client buffer size"
	range 1000 4096 if CANOPENNODE_SDO_CLIENT_BLOCK
	range 7 4096 if CANOPENNODE_SDO_CLIENT_SEGMENTED && !CANOPENNODE_SDO_CLIENT_BLOCK
	default 1000 if CANOPENNODE_SDO_CLIENT_BLOCK
	default 32 if !CANOPENNODE_SDO_CLIENT_BLOCK
	help
	  Circular buffer used by SDO client. Can be <= object size since it is
	  processed over multiple calls. >=7 for segmented; >=1000 recommended for block.

config CANOPENNODE_SDO_CLIENT_TIMEOUT_MS
	int "SDO client timeout (ms)"
	range 50 60000
	default 1000

endmenu

menu "Time producer/consumer - Specified in standard CiA 301"

config CANOPENNODE_TIME_ENABLE
	bool "Enable TIME object and TIME consumer"
	default y

config CANOPENNODE_TIME_PRODUCER
	bool "Enable TIME producer"
	depends on CANOPENNODE_TIME_ENABLE
	default n

config CANOPENNODE_TIME_CALLBACK
	bool "Enable TIME callback"
	depends on CANOPENNODE_TIME_ENABLE
	default y

config CANOPENNODE_TIME_OD_DYNAMIC
	bool "Enable dynamic behaviour of TIME OD variables"
	depends on CANOPENNODE_TIME_ENABLE
	default y

endmenu

menu "SYNC and PDO producer/consumer - Specified in standard CiA 301"

config CANOPENNODE_SYNC_ENABLE
	bool "Enable SYNC object and SYNC consumer"
	default y

config CANOPENNODE_SYNC_PRODUCER
	bool "Enable SYNC producer"
	depends on CANOPENNODE_SYNC_ENABLE
	default y

config CANOPENNODE_SYNC_CALLBACK
	bool "Enable SYNC callback"
	depends on CANOPENNODE_SYNC_ENABLE
	default y

config CANOPENNODE_SYNC_TIMERNEXT
	bool "Enable SYNC timerNext_us calculation"
	depends on CANOPENNODE_SYNC_ENABLE
	default y

config CANOPENNODE_SYNC_OD_DYNAMIC
	bool "Enable dynamic behaviour of SYNC OD variables"
	depends on CANOPENNODE_SYNC_ENABLE
	default y

config CANOPENNODE_RPDO_ENABLE
	bool "Enable receive PDO objects (RPDOs)"
	default y

config CANOPENNODE_TPDO_ENABLE
	bool "Enable transmit PDO objects (TPDOs)"
	default y

config CANOPENNODE_RPDO_TIMERS_ENABLE
	bool "Enable RPDO timers"
	depends on CANOPENNODE_RPDO_ENABLE
	default y

config CANOPENNODE_TPDO_TIMERS_ENABLE
	bool "Enable TPDO timers"
	depends on CANOPENNODE_TPDO_ENABLE
	default y

config CANOPENNODE_PDO_SYNC_ENABLE
	bool "Enable PDO SYNC"
	depends on CANOPENNODE_RPDO_ENABLE || CANOPENNODE_TPDO_ENABLE
	select CANOPENNODE_SYNC_ENABLE
	default y
	help
	  Synchronize PDO processing with network SYNC messages.

config CANOPENNODE_PDO_OD_IO_ACCESS
	bool "Enable PDO OD IO access"
	depends on CANOPENNODE_RPDO_ENABLE || CANOPENNODE_TPDO_ENABLE
	select CANOPENNODE_PDO_OD_DYNAMIC
	default y
	help
	  Use OD IO accessors (OD_IO_t) for mapped PDO variables.

config CANOPENNODE_PDO_CALLBACK
	bool "Enable PDO callback"
	depends on CANOPENNODE_RPDO_ENABLE || CANOPENNODE_TPDO_ENABLE
	default y

config CANOPENNODE_PDO_TIMERNEXT
	bool "Enable PDO timerNext_us calculation"
	depends on CANOPENNODE_RPDO_ENABLE || CANOPENNODE_TPDO_ENABLE
	default y

config CANOPENNODE_PDO_OD_DYNAMIC
	bool "Enable dynamic behaviour of PDO OD variables"
	depends on CANOPENNODE_RPDO_ENABLE || CANOPENNODE_TPDO_ENABLE
	default y

endmenu

menu "Data storage - Data storage with CANopen OD objects 1010 and 1011, CiA 301"

config CANOPENNODE_STORAGE_ENABLE
	bool "Enable data storage"
	default y
	help
	  Persist OD entries via 0x1010/0x1011.

endmenu

menu "Storage Backend"
	depends on CANOPENNODE_STORAGE_ENABLE

choice CANOPENNODE_STORAGE_BACKEND_CHOICE
	prompt "Select CANopenNode OD storage backend"
	default CANOPENNODE_STORAGE_BACKEND_RAM

config CANOPENNODE_STORAGE_BACKEND_SETTINGS
	bool "Zephyr Settings subsystem"
	select SETTINGS
	select CANOPENNODE_CRC16_EXTERNAL
	help
	  Use Zephyr's Settings subsystem to persist OD entries.

config CANOPENNODE_STORAGE_BACKEND_RAM
	bool "RAM-only (no persistence)"
	help
	  Store OD values in RAM only. Lost on reset.

config CANOPENNODE_STORAGE_BACKEND_NONE
	bool "None (disable OD storage)"
	help
	  Disable OD storage completely.

endchoice

endmenu

menu "CANopen LED Indicators - Specified in standard CiA 303-3"

config CANOPENNODE_LEDS_ENABLE
	bool "Enable calculation of the CANopen LED indicators"
	default n

config CANOPENNODE_LEDS_CALLBACK
	bool "Enable custom callback after LED state changes"
	default y if CANOPENNODE_LEDS_ENABLE
	default n if !CANOPENNODE_LEDS_ENABLE

config CANOPENNODE_LEDS_TIMERNEXT
	bool "Enable calculation of timerNext_us for LED indicators"
	default y if CANOPENNODE_LEDS_ENABLE
	default n if !CANOPENNODE_LEDS_ENABLE

endmenu

menu "Safety Related Data Objects (SRDO) - Specified in standard EN 50325-5 (CiA 304)"

config CANOPENNODE_GFC_ENABLE
	bool "Enable GFC (Guarding Function Control)"
	default n

config CANOPENNODE_GFC_CONSUMER
	bool "Enable GFC consumer"
	depends on CANOPENNODE_GFC_ENABLE
	default n

config CANOPENNODE_GFC_PRODUCER
	bool "Enable GFC producer"
	depends on CANOPENNODE_GFC_ENABLE
	default n

config CANOPENNODE_SRDO_ENABLE
	bool "Enable SRDO (Safety Related Data Objects)"
	default n

config CANOPENNODE_SRDO_CHECK_TX
	bool "Enable SRDO TX data check"
	depends on CANOPENNODE_SRDO_ENABLE
	default n

config CANOPENNODE_SRDO_CALLBACK
	bool "Enable SRDO callback"
	depends on CANOPENNODE_SRDO_ENABLE
	default n

config CANOPENNODE_SRDO_TIMERNEXT
	bool "Enable SRDO timerNext_us calculation"
	depends on CANOPENNODE_SRDO_ENABLE
	default n

config CANOPENNODE_SRDO_MINIMUM_DELAY
	int "Minimum time between the first and second SRDO (Tx) message (us)"
	range 0 1000000
	default 0

endmenu

menu "LSS master/slave - Specified in standard CiA 305"

config CANOPENNODE_LSS_SLAVE
	bool "Enable LSS slave"
	default n

config CANOPENNODE_LSS_SLAVE_FASTSCAN_DIRECT_RESPOND
	bool "Enable fast-scan direct response"
	depends on CANOPENNODE_LSS_SLAVE
	default n

config CANOPENNODE_LSS_MASTER
	bool "Enable LSS master"
	default n

config CANOPENNODE_LSS_CALLBACK
	bool "Enable LSS callback"
	default n

endmenu

menu "Gateways - Specified in standard CiA 309"

config CANOPENNODE_GTW_MULTI_NET
	bool "Enable multiple network interfaces in gateway device"
	depends on 0
	default n

config CANOPENNODE_GTW_ASCII
	bool "Enable gateway device with ASCII mapping"
	select CANOPENNODE_FIFO_ENABLE
	select CANOPENNODE_FIFO_ASCII_COMMANDS
	default n

config CANOPENNODE_GTW_ASCII_SDO
	bool "Enable SDO client in gateway-ascii"
	depends on CANOPENNODE_GTW_ASCII
	select CANOPENNODE_SDO_CLIENT_ENABLE
	select CANOPENNODE_FIFO_ASCII_DATATYPES
	default n

config CANOPENNODE_GTW_ASCII_NMT
	bool "Enable NMT master in gateway-ascii"
	depends on CANOPENNODE_GTW_ASCII
	select CANOPENNODE_NMT_MASTER
	default n

config CANOPENNODE_GTW_ASCII_LSS
	bool "Enable LSS master in gateway-ascii"
	depends on CANOPENNODE_GTW_ASCII
	select CANOPENNODE_LSS_MASTER
	default n

config CANOPENNODE_GTW_ASCII_LOG
	bool "Enable non-standard message log read"
	depends on CANOPENNODE_GTW_ASCII
	default n

config CANOPENNODE_GTW_ASCII_ERROR_DESC
	bool "Print error descriptions as comments in gateway-ascii"
	depends on CANOPENNODE_GTW_ASCII
	default n

config CANOPENNODE_GTW_ASCII_PRINT_HELP
	bool "Enable non-standard \"help\" command"
	depends on CANOPENNODE_GTW_ASCII
	default n

config CANOPENNODE_GTW_ASCII_PRINT_LEDS
	bool "Display CANopen status LEDs on terminal"
	depends on CANOPENNODE_GTW_ASCII
	select CANOPENNODE_LEDS_ENABLE
	default n

config CANOPENNODE_GTW_BLOCK_DL_LOOP
	int "Number of process loops in case of block download"
	range 1 127
	default 1
	help
	  Additional local loop iterations while a block download is in progress
	  to speed up transfer (up to 127).

config CANOPENNODE_GTWA_COMM_BUF_SIZE
	int "Size of command buffer in ASCII gateway object"
	range 16 4096
	default 200
	help
	  Increase to >=1000 when doing large block transfers.

config CANOPENNODE_GTWA_LOG_BUF_SIZE
	int "Gateway: log buffer size"
	range 128 4096
	default 2000

endmenu

menu "CRC 16 calculation"

config CANOPENNODE_CRC16_ENABLE
	bool "Enable CRC16 calculation"
	default n

config CANOPENNODE_CRC16_EXTERNAL
	bool "CRC functions are defined externally"
	depends on CANOPENNODE_CRC16_ENABLE
	select CRC
	default y if CANOPENNODE_CRC16_ENABLE
	help
	  If enabled, the application must provide:
	    void crc16_ccitt_single(uint16_t *crc, uint8_t chr);
	    uint16_t crc16_ccitt(const uint8_t block[], size_t len, uint16_t crc);
	  If disabled, the internal CRC16 functions will be used.

endmenu

menu "FIFO buffer"

config CANOPENNODE_FIFO_ENABLE
	bool "Enable FIFO buffer"
	default n

config CANOPENNODE_FIFO_ALT_READ
	bool "FIFO alternate read (needed by SDO client block)"
	depends on CANOPENNODE_FIFO_ENABLE
	default n

config CANOPENNODE_FIFO_CRC16_CCITT
	bool "FIFO CRC16-CCITT (needed by SDO client block)"
	depends on CANOPENNODE_FIFO_ENABLE
	select CANOPENNODE_CRC16_ENABLE
	default n

config CANOPENNODE_FIFO_ASCII_COMMANDS
	bool "FIFO ASCII command helpers"
	depends on CANOPENNODE_FIFO_ENABLE
	default n

config CANOPENNODE_FIFO_ASCII_DATATYPES
	bool "FIFO ASCII datatype helpers"
	depends on CANOPENNODE_FIFO_ENABLE && CANOPENNODE_FIFO_ASCII_COMMANDS
	default n
	help
	  Helpers to read/write integers/floats/strings in ASCII.

endmenu

menu "Trace recorder"

config CANOPENNODE_TRACE_ENABLE
	bool "Enable Trace recorder"
	default n

config CANOPENNODE_TRACE_OWN_INTTYPES
	bool "Provide custom PRIu32/PRId32 macros (no <inttypes.h>)"
	depends on CANOPENNODE_TRACE_ENABLE
	default n

endmenu

menu "Debug messages"

config CANOPENNODE_DEBUG_COMMON
	bool "Define default CO_DEBUG_COMMON(msg) macro"
	default n

config CANOPENNODE_DEBUG_SDO_CLIENT
	bool "Define default CO_DEBUG_SDO_CLIENT(msg) macro"
	default n

config CANOPENNODE_DEBUG_SDO_SERVER
	bool "Define default CO_DEBUG_SDO_SERVER(msg) macro"
	default n

endmenu

menu "Object Dictionary (EDS)"

config CANOPENNODE_EDS_FILE_PATH
	string "EDS file (path relative to application root)"
	default ""
	help
	  Path to the EDS used to generate OD.c/OD.h.
	  Leave empty to use:
	    example/DS301_profile.eds

endmenu

menu "CANopenNode TX Workqueue Options"

config CANOPENNODE_TX_WORKQUEUE_STACK_SIZE
	int "TX workqueue stack size"
	default 1024
	range 256 16384
	help
	  Stack size (in bytes) for the CANopenNode TX workqueue thread.

config CANOPENNODE_TX_WORKQUEUE_PRIORITY
	int "TX workqueue priority"
	default 0
	help
	  Thread priority for the CANopenNode TX workqueue.
	  Lower numbers mean higher priority.

endmenu

menu "CANopenNode Thread Options"

config CANOPENNODE_RT_THREAD
	bool "Use real-time thread for CANopen processing"
	default y
	help
	  If enabled, a dedicated real-time thread will be created for CANopen
	  processing. Otherwise, the application must call CO_process() periodically.

config CANOPENNODE_RT_THREAD_STACK_SIZE
	int "Real-time thread stack size"
	default 1024
	help
	  Stack size (bytes) for the CANopenNode real-time thread.
	  Only used if CANOPENNODE_RT_THREAD is enabled.
	  Increase if you use many PDOs, SDOs, or large OD entries.
	  Decrease if you have memory constraints and use few CANopen features.
	  Typical values: 1024-4096 bytes.
	  Measure actual stack usage to optimize.

config CANOPENNODE_RT_THREAD_PRIORITY
	int "Real-time thread priority"
	default -1
	help
	  Thread priority for the CANopenNode real-time thread.
	  Only used if CANOPENNODE_RT_THREAD is enabled.
	  Lower numbers mean higher priority.
	  Typical values: -1 to -3 for real-time processing.

config CANOPENNODE_RT_THREAD_IDLE_MS
	int "Real-time thread idle time (ms)"
	default 10
	help
	  Time (ms) the CANopenNode real-time thread sleeps when idle.
	  Only used if CANOPENNODE_RT_THREAD is enabled.
	  Lower values mean more CPU usage but lower latency.
	  Typical values: 1-100 ms.

config CANOPENNODE_RT_THREAD_TIMERNEXT
	bool "Enable timerNext_us calculation in real-time thread"
	default y
	help
	  If enabled, timerNext_us will be calculated in the real-time thread.
	  Only used if CANOPENNODE_RT_THREAD is enabled.
	  Disable to save CPU if you don't use features that need timerNext_us.

config CANOPENNODE_RT_THREAD_AUTO_START
	bool "Auto-start CANopenNode real-time thread"
	default y
	help
	  If enabled, the CANopenNode real-time thread will be started automatically
	  at POST_KERNEL. Otherwise, you must call CO_RT_threadStart() manually.
endmenu

menu "CANopenNode Initialization"

config CANOPENNODE_INIT_PRIORITY
	int "CANopenNode initialization priority"
	default 90
	help
	  Priority for CANopenNode initialization.
	  Lower numbers mean earlier initialization.
	  Typical values: 80-100.
	  Must be lower than the application's main thread priority.

config CANOPENNODE_INIT_NODE_ID
	int "CANopenNode node ID"
	default 1
	range 0 127
	help
	  Node ID for the CANopenNode instance.
	  Must be unique on the CAN bus.

config CANOPENNODE_NODE_ID_CALLBACK
	bool "Allow application-supplied Node-ID callback"
	default n
	help
	  Enable an application callback for dynamic Node-ID selection.

	  Register your callback BEFORE calling co_canopen_start():
	    co_canopen_register_node_id_cb(my_node_id_cb, my_ctx);

	  The callback must return a Node-ID in the range 1..127.
	  Return 0 to indicate "unspecified". If the callback is not
	  registered or returns 0/out-of-range, the value from
	  CONFIG_CANOPENNODE_INIT_NODE_ID is used as the fallback.

endmenu

endif # CANOPENNODE
```
