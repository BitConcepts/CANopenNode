## Kconfig
```kconfig
# CANopenNode CANopen protocol stack configuration options
#
# Copyright (c) 2019 Vestas Wind Systems A/S
# SPDX-License-Identifier: Apache-2.0

config CANOPENNODE
	bool "CANopenNode support"
	depends on CAN
	help
	  This option enables the CANopenNode library.

if CANOPENNODE

source "modules/canopennode/Kconfig.roles"
source "modules/canopennode/Kconfig.core"
source "modules/canopennode/Kconfig.optional"

# Conditionally include Zephyr-specific config
if ZEPHYR_BASE
source "modules/canopennode/zephyr/Kconfig.zephyr"
endif

endif # CANOPENNODE
```

## Kconfig.core
```kconfig
config CANOPENNODE_EDS_FILE_PATH
    string "EDS file used to generate Object Dictionary"
    default ""
    help
      Path to the EDS (Electronic Data Sheet) file used to generate the
      CANopenNode object dictionary files (OD.h, OD.c).

      This file is passed into the eds2c.py code generator. You may override
      this to use a board-specific or application-specific EDS file.

      The path may be relative to the workspace root.

config CANOPENNODE_SDO_BUFFER_SIZE
	int "CANopen SDO buffer size"
	default 32
	range 7 889
	help
	  Size of the internal CANopen SDO buffer in bytes. Must be large enough to hold the
	  largest variable in the object dictionary.

config CANOPENNODE_TRACE_BUFFER_SIZE
	int "CANopen trace buffer size"
	default 100
	help
	  Size of the CANopen trace buffer in bytes.

config CANOPENNODE_TX_WORKQUEUE_STACK_SIZE
	int "Stack size for the CANopen transmit workqueue"
	default 512
	help
	  Stack size used for the internal CANopen transmit workqueue.

config CANOPENNODE_TX_WORKQUEUE_PRIORITY
	int "Priority for CANopen transmit workqueue"
	default 0 if !COOP_ENABLED
	default -1
	help
	  Priority of the CANopen transmit workqueue.
```

## Kconfig.optional
```kconfig
config CANOPENNODE_STORAGE
	bool "CANopen object dictionary storage"
	depends on SETTINGS
	default y
	help
	  Enable storing the CANopen object dictionary to non-volatile storage.

config CANOPENNODE_STORAGE_HANDLER_ERASES_EEPROM
	bool "Erase CANopen object dictionary EEPROM entries in storage handler"
	depends on CANOPENNODE_STORAGE
	help
	  Erase EEPROM entries upon write to OD index 0x1011 subindex 1.

config CANOPENNODE_LEDS
	bool "CANopen LED indicators"
	default y
	help
	  Enable support for CANopen LED indicators (CiA 303-3).

config CANOPENNODE_LEDS_BICOLOR
	bool "CANopen bicolor LED indicator"
	depends on CANOPENNODE_LEDS
	help
	  Treat LEDs as one bicolor LED, favoring red per CiA 303-3.

config CANOPENNODE_SYNC_THREAD
	bool "CANopen SYNC thread"
	default y
	help
	  Use an internal thread to process SYNC RPDOs and TPDOs.

config CANOPENNODE_SYNC_THREAD_STACK_SIZE
	int "Stack size for the CANopen SYNC thread"
	depends on CANOPENNODE_SYNC_THREAD
	default 512
	help
	  Stack size for the internal SYNC processing thread.

config CANOPENNODE_SYNC_THREAD_PRIORITY
	int "Priority for CANopen SYNC thread"
	depends on CANOPENNODE_SYNC_THREAD
	default 0 if !COOP_ENABLED
	default -5
	help
	  Thread priority for SYNC processing.

config CANOPENNODE_PROGRAM_DOWNLOAD
	bool "CANopen program download"
	depends on BOOTLOADER_MCUBOOT
	select IMG_MANAGER
	default y if CANOPENNODE_ROLE_COMBINED
	help
	  Enable CiA 302-3 based program download over CANopen.
```

## Kconfig.roles
```kconfig
comment "CANopen Communication Role Selection"

choice CANOPENNODE_ROLE
	prompt "CANopen node communication role"
	default CANOPENNODE_ROLE_SERVER

config CANOPENNODE_ROLE_CLIENT
	bool "Client (initiates SDO requests)"
	help
	  CANopen node acting as a client (e.g., NMT master, network manager, update tool).
	  Enables SDO client and LSS master functionality.

config CANOPENNODE_ROLE_SERVER
	bool "Server (responds to SDO requests)"
	help
	  Typical CANopen node acting as a device/slave, responding to SDO client transfers.

config CANOPENNODE_ROLE_COMBINED
	bool "Combined (Client + Server)"
	help
	  Gateway or dual-role device (e.g., bootloader host and target). Enables both roles.

endchoice

config CANOPENNODE_ROLE_CONTROLLER
    bool "CANopen Controller (Client/Master)"
    select CANOPENNODE_SDO_CLIENT
    select CANOPENNODE_LSS_CLIENT

config CANOPENNODE_ROLE_DEVICE
    bool "CANopen Device (Server/Slave)"
    select CANOPENNODE_SDO_SERVER
    select CANOPENNODE_LSS_SERVER

config CANOPENNODE_LSS
    bool "Enable Layer Setting Services (LSS)"
    depends on CANOPENNODE
    help
      Enable support for CiA 305 LSS functionality.

config CANOPENNODE_LSS_CLIENT
    bool "Enable LSS Client (master role)"
    depends on CANOPENNODE_LSS
    help
      Enable the LSS client role. Used in tools that configure other nodes.

config CANOPENNODE_LSS_SERVER
    bool "Enable LSS Server (slave role)"
    depends on CANOPENNODE_LSS
    help
      Enable the LSS server role. Used in nodes that are being configured.

config CANOPENNODE_SDO_CLIENT
	bool
	default y if CANOPENNODE_ROLE_CLIENT || CANOPENNODE_ROLE_COMBINED

config CANOPENNODE_SDO_SERVER
	bool
	default y if CANOPENNODE_ROLE_SERVER || CANOPENNODE_ROLE_COMBINED

config CANOPENNODE_LSS_MASTER
	bool
	default y if CANOPENNODE_ROLE_CLIENT || CANOPENNODE_ROLE_COMBINED

config CANOPENNODE_LSS_SLAVE
	bool
	default y if CANOPENNODE_ROLE_SERVER || CANOPENNODE_ROLE_COMBINED
```

## tests/zephyr/unit/od_interface/testcase.yaml
```yaml
tests:
  canopen.od_interface.native_sim:
    harness: ztest
    platform_allow:
      - native_sim
      - native_sim/native/64
    tags:
      - canopen
      - od
      - interface

  canopen.od_interface.qemu_x86:
    harness: ztest
    platform_allow:
      - qemu_x86
    tags:
      - canopen
      - od
      - interface
      - qemu

  canopen.od_interface.qemu_cortex_m3:
    harness: ztest
    platform_allow:
      - qemu_cortex_m3
    tags:
      - canopen
      - od
      - interface
      - qemu
      - arm
```

## tests/zephyr/unit/pdo_bitwise/testcase.yaml
```yaml
tests:
  canopen.pdo_bitwise.native_sim:
    harness: ztest
    platform_allow:
      - native_sim
      - native_sim/native/64
    tags:
      - canopen
      - pdo
      - bitwise_mapping
      - regression

  canopen.pdo_bitwise.qemu_x86:
    harness: ztest
    platform_allow:
      - qemu_x86
    tags:
      - canopen
      - pdo
      - bitwise_mapping
      - regression
      - qemu

  canopen.pdo_bitwise.qemu_cortex_m3:
    harness: ztest
    platform_allow:
      - qemu_cortex_m3
    tags:
      - canopen
      - pdo
      - bitwise_mapping
      - qemu
      - arm
```
